/*===================================================================
1.电量测量盒子
2.AcMeter_60A
//=================================================================*/
//===================================================================
void setup() {
  //------------------------------------------------
  lgsetup("AVW_BOX_Nano_LcdShow_WiFi_2 ...");
  //------------------------------------------------
  LCD1602_setup(); LCD1602_Clear();
  LCD1602_Show(0, 0, F("AVW_Nano_WiFi!"));
  //------------------------------------------------
  AVW_Setup();
  //------------------------------------------------
  wifi_Init(false); lewei_time_init();
  //------------------------------------------------
  tLoop_Setup();
  //------------------------------------------------
}
void loop(void) {
  //------------------------------------------
  work(); //smartDelay(10 * 1000);
  //------------------------------------------
  lgFeed(); wfs_loop();
  //------------------------------------------
}
//===============================================
void work() {
  //------------------------------------------
  if (t1s_loop()) {
    AVW_Loop();
    LCD_Loop(true);
    RunTimeLoop();
  }
  //------------------------------------------
  if (t20s_loop()) {
    lgln("Lewei_Loop()");
    Lewei_Loop(); lewei_time_exp();
    lewei_time_show();
  }
  //------------------------------------------
  lgFeed(); wfs_loop();
  //------------------------------------------
}
//===============================================
static void smartDelay(unsigned long ms) {
  unsigned long start = millis(); do {
    //------------------------------------------
    lgFeed(); wfs_loop();
    //------------------------------------------
  } while (millis() - start < ms);
}
//===============================================
