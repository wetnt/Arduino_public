#include <Time.h>
#include <TinyGPS++.h>
#include <SoftwareSerial.h>
#include <dht.h>

SoftwareSerial myGps(10, 11); // RX, TX
TinyGPSPlus gps;

void setup()
{
  Serial.begin(9600);
  myGps.begin(4800);
  while (!Serial) {}
  Serial.println("gps_mini_ok");
}




//-------------------------------------------------------------------------
void loop() 
{
  //-------------------------------------------------------------------------
  SerialRead();
  //-----------------------------
  GpsRead();
  GpsSetValue();
  //-----------------------------
  DHT11Read();
  //-------------------------------------------------------------------------
  GpsCheck();
  GpsReport();
  //-------------------------------------------------------------------------
}

void SerialRead()
{
  //-------------------------------------------------------------------------
  while (Serial.available()>0)
  {
    SerialExp(Serial.read());    
  }
  //-------------------------------------------------------------------------
}

void GpsRead()
{
  //-------------------------------------------------------------------------
  while (myGps.available())
  {
    gps.encode(myGps.read());
  }
  //-------------------------------------------------------------------------
}
