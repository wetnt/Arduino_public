//-------------------------------------------------------------------------
#include <LCD5110_Graph.h>
LCD5110 myGLCD(3,4,5,6,7);
//-------------------------------------------------------------------------
extern uint8_t SmallFont[];
extern unsigned char TinyFont[];
//-------------------------------------------------------------------------

//-------------------------------------------------------------------------
unsigned long NoowTime = 0;
//-------------------------------------------------------------------------
unsigned long ShowTime = 0;
int ShowTimeKey = 1000;//5s
//-------------------------------------------------------------------------

//-------------------------------------------------------------------------
int	TimeZone = 8;
int	lengGPRMC = 100;
char	charGPRMC[100] = "";
char	HeadGPRMC[7] = "$GPRMC";
char	byteGPS = '0';
int	gpsreadcount = 0;
int	dotIndexs[13];
//-------------------------------------------------------------------------
int YY,MT,DD,HH,MM,SC,MS;
boolean KK = 0;
float WW = 0, JJ = 0, VV = 0, FF = 0;
//-----------------------------------------------------------------

void BBKGPS(HardwareSerial *gpsports,int baudrates,int TimeZones) //构造函数，名字要与类名相同，内部可有过程，但没有返回值，一般用于初始化功能
{
  //-----------------------------------------------------------------
  //gpsport = gpsports;
  Serial.begin(baudrates);
  delay(200);
  //-----------------------------------------------------------------
  TimeZone = TimeZones;
  //-----------------------------------------------------------------
  TempValueClear();
  //----------------------------------------------------------------- 
}




void TempValueClear()
{
  //-----------------------------------------------------------------
  gpsreadcount = 0;
  //-----------------------------------------------------------------
  for (int i=0;i<lengGPRMC;i++){ 
    charGPRMC[i] = 0;
  }
  //-----------------------------------------------------------------
}

char ReadAddGPRMC()
{
  //-----------------------------------------------------------------
  byteGPS = Serial.read();
  charGPRMC[gpsreadcount] = byteGPS;
  gpsreadcount++;
  return byteGPS;
  //-----------------------------------------------------------------
}

boolean CheckHeadGPRMC()
{
  //-----------------------------------------------------------------
  int bien = 0;
  for(int i=0;i<6;i++){
    //-----------------------------------------
    //Serial.print(charGPRMC[i]); 
    //Serial.print("==");
    //Serial.print(HeadGPRMC[i]);
    //Serial.println();
    //-----------------------------------------
    if( charGPRMC[i] == HeadGPRMC[i] ){ 
      bien++; 
    }
  }
  //-----------------------------------------------------------------
  if( bien == 6 ){ 
    return 1; 
  }
  return 0;
  //-----------------------------------------------------------------
}

void MarkDotGPRMC()
{
  //-----------------------------------------------------------------
  int cont = 0;
  for (int i=0;i<lengGPRMC;i++){
    if ( charGPRMC[i] == ',' ){ 
      dotIndexs[cont] = i; 
      cont++; 
    }
  }
  //-----------------------------------------------------------------
}

void GetDateTime(int i,int j)
{
  //-----------------------------------------------------------------
  DD = (charGPRMC[i+0]-48)*10 + (charGPRMC[i+1]-48);
  MT = (charGPRMC[i+2]-48)*10 + (charGPRMC[i+3]-48);
  YY = (charGPRMC[i+4]-48)*10 + (charGPRMC[i+5]-48);
  //-----------------------------------------------------------------
  HH = (charGPRMC[j+0]-48)*10 + (charGPRMC[j+1]-48);
  MM = (charGPRMC[j+2]-48)*10 + (charGPRMC[j+3]-48);
  SC = (charGPRMC[j+4]-48)*10 + (charGPRMC[j+5]-48);
  MS = MS+(charGPRMC[j+7]-48)*100;
  MS = MS+(charGPRMC[j+8]-48)*10; 
  MS = MS+(charGPRMC[j+9]-48);
  //-----------------------------------------------------------------
  HH = HH + TimeZone;
  if(HH>= 24){ 
    HH = HH - 24; 
    DD = DD +  1; 
  }
  //-----------------------------------------------------------------
}

float GetLongLat(int j)
{
  //-----------------------------------------------------------------
  long x = 0;
  x  = ( charGPRMC[j+0] - 48 ) * 10;
  x += ( charGPRMC[j+1] - 48 );
  //-----------------------------------------------------------------
  float y = x + GetIDValue(j+2) / 60;
  //-----------------------------------------------------------------
  if( charGPRMC[j+10] == 83 ) { 
    y = (y)*-1; 
  }
  //-----------------------------------------------------------------
  return y;
  //-----------------------------------------------------------------
}

float GetLongLon(int j)
{
  //-----------------------------------------------------------------
  long x = 0;
  x  = ( charGPRMC[j+0] - 48 ) * 100;
  x += ( charGPRMC[j+1] - 48 ) *  10;
  x += ( charGPRMC[j+2] - 48 );
  //-----------------------------------------------------------------
  float y = x + GetIDValue(j+3) / 60;
  //-----------------------------------------------------------------
  if( charGPRMC[j+11] == 87 ) { 
    y = (y)*-1; 
  }
  //-----------------------------------------------------------------
  return y;
  //-----------------------------------------------------------------
}

boolean GetGpsLock(int j)
{
  //-----------------------------------------------------------------
  if( charGPRMC[ j ] == 'A'){
    return 1;
  }
  else{
    return 0;
  }
  //-----------------------------------------------------------------
  return 0;
  //-----------------------------------------------------------------
}


float GetSpedKMH(int j)
{
  return GetIDValue(j) * 1.852;
}

float GetOrientD(int j)
{
  return GetIDValue(j);
}

float GetIDValue(int j){
  //-----------------------------------------------------------------
  int dotIndex = 0;
  int strigEnd = 0;
  float x = 0, tempNumb = 1;
  //-----------------------------------------------------------------
  for (int i=0;i<12;i++){
    if( charGPRMC[j+i] == '.' ){ 
      dotIndex = i; 
      i=99;
    }
  }
  //-----------------------------------------------------------------
  for (int i=0;i<12;i++){
    if( charGPRMC[j+i] == ',' ){ 
      strigEnd = i;  
      i=99;
    }
  }
  //-----------------------------------------------------------------
  if( dotIndex == 0 ){ 
    return 0; 
  }
  if( strigEnd == 0 ){ 
    return 0; 
  }
  if( strigEnd <= dotIndex ){ 
    return 0; 
  }
  //-----------------------------------------------------------------
  tempNumb = 1;
  for (int i=0;i<dotIndex;i++){
    x = x + ( charGPRMC[j + dotIndex - i -1] - 48 ) * tempNumb;
    tempNumb = tempNumb * 10;
  }
  //-----------------------------------------------------------------
  tempNumb = 0.1;
  for (int i=dotIndex+1;i<strigEnd;i++){
    x = x + ( charGPRMC[j + i] - 48 ) * tempNumb;
    tempNumb = tempNumb * 0.1;
  }
  //-----------------------------------------------------------------
  return x;
  //-----------------------------------------------------------------
}





//$GPRMC,160546.000,A,3958.8450,N,11621.4676,E,0.00,,110412,,*12
//$GPRMC,000250.599,V,3958.8450,N,11621.4676,E,0.00,0.00,060180,,,N*7C
void converNMEA()
{
  //-----------------------------------------------------------------
  MarkDotGPRMC();
  //-----------------------------------------------------------------
  GetDateTime(     dotIndexs[8] + 1, dotIndexs[0] + 1 );
  KK = GetGpsLock( dotIndexs[1] + 1 );
  WW = GetLongLat( dotIndexs[2] + 1 );
  JJ = GetLongLon( dotIndexs[4] + 1 );
  VV = GetSpedKMH( dotIndexs[6] + 1 );
  FF = GetOrientD( dotIndexs[7] + 1 );
  //-----------------------------------------------------------------
}

void Read()
{
  //-----------------------------------------------------------------
  if( Serial.available() <= 0 ) { 
    delay(0);
  }
  //-----------------------------------------------------------------
  if( Serial.available() > 0 ) {
    //-----------------------------------------------------------------
    ReadAddGPRMC(); //read byteGPS
    //-----------------------------------------------------------------
    if( byteGPS == 13 ){
      //-----------------------------------------------------------------
      Serial.print(charGPRMC);
      if( CheckHeadGPRMC() ){ converNMEA(); }
      //-----------------------------------------------------------------      
      TempValueClear();
      //-----------------------------------------------------------------
    }
    if( byteGPS == 10 ){
      TempValueClear(); 
    }
    //-----------------------------------------------------------------
  }
  //-----------------------------------------------------------------	
}


void setup() 
{
  //-------------------------------------------------------------------------
  myGLCD.InitLCD(50);
  //-------------------------------------------------------------------------
  myGLCD.setFont(SmallFont);
  myGLCD.clrScr();
  myGLCD.print("GPS Read Start", CENTER, 14); 
  myGLCD.setFont(TinyFont);
  myGLCD.print("(C)2013 by", CENTER, 36);
  myGLCD.print("BOBOKing.COM", CENTER, 42);
  myGLCD.update();
  //-------------------------------------------------------------------------
  //Serial.begin(9600);
  delay(500); 
  //-------------------------------------------------------------------------
  BBKGPS(&Serial,9600,TimeZone);
  //-------------------------------------------------------------------------
  myGLCD.setFont(SmallFont);
  myGLCD.clrScr();
  myGLCD.print("HardwareSerial", CENTER, 10); 
  myGLCD.print("Read Start", CENTER, 24); 
  myGLCD.update();
  delay(500); 
  //-------------------------------------------------------------------------
  TempValueClear(); 
  //-------------------------------------------------------------------------
}

void loop() 
{
  //-------------------------------------------------------------------------
  NoowTime = millis();
  //-------------------------------------------------------------------------
  Read();
  //-------------------------------------------------------------------------
  if( NoowTime - ShowTime > ShowTimeKey){ 
    ShowTime = NoowTime;
    GpsLCDShow();
  }
  //-------------------------------------------------------------------------
}

char str[20];
void GpsLCDShow(){
  //-------------------------------------------------------------------------
  myGLCD.clrScr();
  myGLCD.setFont(SmallFont);
  //-------------------------------------------------------------------------
  String tDate = String( String(YY,DEC) + "/" + String(MT,DEC) + "/" + String(DD,DEC) );
  tDate = String( String(MT,DEC) + "/" + String(DD,DEC) );
  String tTime = String( String(HH,DEC) + ":" + String(MM,DEC) + ":" + String(SC,DEC) );
  dtostrf(WW,3,6,str); 
  String tLats = str; 
  dtostrf(JJ,3,6,str); 
  String tLons = str; 
  dtostrf(VV,4,2,str); 
  String tVels = str; 
  dtostrf(FF,4,2,str); 
  String tFans = str; 
  String tKeys = "V"; 
  if(KK){ 
    tKeys = "A"; 
  }
  //-------------------------------------------------------------------------
  myGLCD.print(tDate, 0,  0);  
  myGLCD.print(tTime, 36,  0);
  myGLCD.print("W:",  0,  9);  
  myGLCD.print(tLats, 18,  9);
  myGLCD.print("J:",  0, 18);  
  myGLCD.print(tLons, 18, 18);
  myGLCD.print(tKeys+":",  0, 27);  
  myGLCD.print(tVels, 18, 27);
  myGLCD.print("F:",  0, 36);  
  myGLCD.print(tFans, 18, 36);
  //-------------------------------------------------------------------------
  myGLCD.print(charGPRMC,  0, 36);  
  //-------------------------------------------------------------------------
  myGLCD.update();
  //-------------------------------------------------------------------------
}
